## drivers/net/wireless/realtek/rtl8812au/Kconfig
```kconfig
config 88XXAU
	tristate "Realtek 88XXau USB WiFi"
	default n
	depends on USB && NETHUNTER_USB_SUPPORT
	help
	  RTL88XXAU drivers for Kali Nethunter
```

## drivers/net/wireless/realtek/rtl88x2bu/Kconfig
```kconfig
config RTL88X2BU
	tristate "Realtek 88X2BU USB WiFi"
	default y if NETHUNTER_USB_SUPPORT
	depends on USB && NETHUNTER_USB_SUPPORT
	help
	  RTL88X2BU drivers for Kali Nethunter
```

## drivers/nethunter/Kconfig
```kconfig
menu "NetHunter Support"

config NETHUNTER_SUPPORT
	bool "Basic nethunter support"
	default n
	help
		Enable basic nethunter support in-kernel which are sysvipc, module support, hci0 support and mac80211 support.

	select MODULES
	select MODULE_FORCE_LOAD
	select MODULE_UNLOAD
	select MODVERSIONS
	
	select SYSVIPC
	select SYSVIPC_SYSCTL
	select POSIX_MQUEUE
	
	select IKCONFIG
	select CPUSETS
	select AUTOFS4_FS
	select TMPFS_XATTR
	select TMPFS_POSIX_ACL
	select CGROUPS
	select CGROUP_DEVICE
	
	select NAMESPACES
	select UTS_NS
	select IPC_NS
	select USER_NS
	select PID_NS
	select NET_NS
	
	select DEVTMPFS
	select DEVTMPFS_MOUNT
	select FSNOTIFY
	select DNOTIFY
	select INOTIFY_USER
	select FANOTIFY
	select FANOTIFY_ACCESS_PERMISSIONS
	select MMC
	select FHANDLE
	select EPOLL
	select SIGNALFD
	select TIMERFD
	
	select BT
	select BT_BREDR
	select BT_RFCOMM
	select BT_RFCOMM_TTY
	select BT_BNEP
	select BT_BNEP_MC_FILTER
	select BT_BNEP_PROTO_FILTER
	select BT_HIDP
	select BT_HS
	select BT_LE
	select BT_LEDS
	select BT_HCIBFUSB
	select BT_HCIBTSDIO
	select BT_HCIBTUSB
	select BT_HCIBTUSB_BCM
	select BT_HCIBTUSB_RTL
	select BT_HCIUART
	select BT_HCIVHCI
	select BT_HCIBCM203X
	select BT_HCIBPA10X

config NETHUNTER_ETHERNET_SUPPORT
	tristate "Ethernet drivers support"
	default y if NETHUNTER_SUPPORT
	depends on NETHUNTER_SUPPORT
	help
		Enable rtl ethernet drivers support.

	select DNS_RESOLVER
	select USB_RTL8150
	select USB_RTL8152
	select CFG80211
	select CFG80211_WEXT
	select MAC80211
	select MAC80211_MESH
	select MAC80211_RC_MINSTREL
	select MAC80211_RC_MINSTREL_HT
	select MAC80211_RC_MINSTREL_VHT

config NETHUNTER_SDR_SUPPORT
	tristate "SDR support"
	default y if NETHUNTER_SUPPORT
	depends on NETHUNTER_SUPPORT
	help
		Enable SDR drivers support like airspy, hackrf and msi2500.

	select MEDIA_SUPPORT
	select MEDIA_SDR_SUPPORT
	select MEDIA_USB_SUPPORT
	select MEDIA_DIGITAL_TV_SUPPORT
	select MEDIA_TUNER
	select MEDIA_TUNER_MSI001
	select MEDIA_TUNER_R820T
	select USB_AIRSPY
	select USB_HACKRF
	select USB_MSI2500
	select DVB_RTL2830
	select DVB_RTL2832
	select DVB_RTL2832_SDR
	select DVB_SI2168
	select DVB_ZD1301_DEMOD

config NETHUNTER_HID_SUPPORT
	tristate "HID support"
	default y if NETHUNTER_SUPPORT
	depends on NETHUNTER_SUPPORT
	help
		Enable HID support to perform HID attacks with external gadgets and such.

	select HID_BATTERY_STRENGTH
	select HIDRAW
	select UHID
	select HID_GENERIC
	select HID_A4TECH
	select HID_ACCUTOUCH
	select HID_ACRUX
	select HID_ACRUX_FF
	select HID_APPLE
	select HID_APPLEIR
	select HID_ASUS
	select HID_AUREAL
	select HID_BELKIN
	select HID_BETOP_FF
	select HID_CHERRY
	select HID_CHICONY
	select HID_CORSAIR
	select HID_PRODIKEYS
	select HID_CMEDIA
	select HID_CP2112
	select HID_CYPRESS
	select HID_DRAGONRISE
	select HID_EMS_FF
	select HID_ELECOM
	select HID_ELO
	select HID_EZKEY
	select HID_GEMBIRD
	select HID_GFRM
	select HID_HOLTEK
	select HID_GT683R
	select HID_KEYTOUCH
	select HID_KYE
	select HID_UCLOGIC
	select HID_WALTOP
	select HID_GYRATION
	select HID_ICADE
	select HID_ITE
	select HID_TWINHAN
	select HID_KENSINGTON
	select HID_LCPOWER
	select HID_LED
	select HID_LENOVO
	select HID_LOGITECH
	select HID_LOGITECH_DJ
	select HID_LOGITECH_HIDPP
	select HID_MAGICMOUSE
	select HID_MAYFLASH
	select HID_MICROSOFT
	select HID_MONTEREY
	select HID_MULTITOUCH
	select HID_NTI
	select HID_NTRIG
	select HID_ORTEK
	select HID_PANTHERLORD
	select HID_PENMOUNT
	select HID_PETALYNX
	select HID_PICOLCD
	select HID_PICOLCD_FB
	select HID_PICOLCD_BACKLIGHT
	select HID_PICOLCD_LEDS
	select HID_PLANTRONICS
	select HID_PRIMAX
	select HID_RETRODE
	select HID_ROCCAT
	select HID_SAITEK
	select HID_SAMSUNG
	select HID_SONY
	select HID_SPEEDLINK
	select HID_STEELSERIES
	select HID_SUNPLUS
	select HID_RMI
	select HID_GREENASIA
	select HID_SMARTJOYPLUS
	select HID_TIVO
	select HID_TOPSEED
	select HID_THINGM
	select HID_THRUSTMASTER
	select HID_UDRAW_PS3
	select HID_WACOM
	select HID_WIIMOTE
	select HID_XINMO
	select HID_ZEROPLUS
	select HID_ZYDACRON
	select HID_SENSOR_HUB
	select HID_SENSOR_CUSTOM_SENSOR
	select HID_ALPS
	select HID_QVR
	select USB_HID
	select USB_HIDDEV
	select I2C_HID
	select HID_PID

config NETHUNTER_USB_SUPPORT
	tristate "USB support"
	default y if NETHUNTER_SUPPORT
	depends on NETHUNTER_SUPPORT
	help
		Enable USB support for nethunter usage like otg access, mtp, rndis and eem.

	select USB
	select USB_ACM
	select USB_OTG
	select USB_MON
	select USB_WDM
	select USB_STORAGE
	select USB_XHCI_HCD
	select USB_EHCI_HCD
	select USB_USB_ANNOUNCE_NEW_DEVICES
	select USB_COMMON
	select USB_SUPPORT
	select USB_OHCI_LITTLE_ENDIAN
	select USB_ARCH_HAS_HCD
	
	select USB_SERIAL
	select USB_SERIAL_CONSOLE
	select USB_SERIAL_GENERIC
	select USB_SERIAL_SIMPLE
	select USB_SERIAL_QCAUX
	select USB_SERIAL_QUALCOMM
	select USB_SERIAL_CH341
	select USB_SERIAL_CP210X
	select USB_SERIAL_FTDI_SIO
	select USB_SERIAL_PL2303
	
	select USB_GADGET
	select USB_CONFIGFS_SERIAL
	select USB_CONFIGFS_ACM
	select USB_CONFIGFS_OBEX
	select USB_CONFIGFS_NCM
	select USB_CONFIGFS_ECM_SUBSET
	select USB_CONFIGFS_RNDIS
	select USB_CONFIGFS_EEM
	select USB_CONFIGFS_MASS_STORAGE
	select USB_CONFIGFS_RMNET_BAM
	select USB_CONFIGFS_MBIM_BAM
	select USB_CONFIGFS_F_UAC1
	select USB_CONFIGFS_F_UAC2
	select USB_CONFIGFS_F_UVC
	select USB_CONFIGFS_F_PRINTER
	select USB_CONFIGFS_F_GSI
	select USB_CONFIGFS_F_IPC
	select USB_LAN78XX

config NETHUNTER_WIFI_DRIVERS_SUPPORT
	tristate "WiFi drivers support"
	default y if NETHUNTER_SUPPORT
	depends on NETHUNTER_SUPPORT
	help
		Enable ath9k, mt7601, ralink, realtek, and zydas drivers support.

	select WLAN_VENDOR_ATH
	select WLAN_VENDOR_RALINK
	select WLAN_VENDOR_MEDIATEK
	select ATH9K_HTC
	select CARL9170
	select ATH6KL
	select ATH6KL_USB
	select LIBERTAS
	select MT7601U
	select RT2X00
	select RT2500USB
	select RT73USB
	select RT2800USB
	select RT2800USB_RT33XX
	select RT2800USB_RT35XX
	select RT2800USB_RT3573
	select RT2800USB_RT53XX
	select RT2800USB_RT55XX
	select RT2800USB_UNKNOWN
	select WLAN_VENDOR_REALTEK
	select RTL8187
	select RTL_CARDS
	select RTL8192CU
	select RTL8XXXU
	select RTL8XXXU_UNTESTED
	select WLAN_VENDOR_ZYDAS
	select USB_ZD1201
	select ZD1211RW
	select USB_NET_RNDIS_WLAN
	select MACVLAN
	select CHECKPOINT_RESTORE
	select UNIX_DIAG
	select PACKET_DIAG
	select NETLINK_DIAG

endmenu
```

## drivers/rekernel/Kconfig
```kconfig
config REKERNEL
	tristate "Re:Kernel"
	default n
	help
	  Support Re:Kernel for better Tombstone functionality.
```
